/**
 * These arguments were used when this file was generated. They will be automatically applied on subsequent loads
 * via the GUI or CLI. Run CLI with '--help' for additional information on how to override these arguments.
 * @cliArgs --device "MSPM0G351X" --part "Default" --package "LQFP-100(PZ)" --product "mspm0_sdk@2.11.00.07"
 * @v2CliArgs --device "MSPM0G3519" --package "LQFP-100(PZ)" --product "mspm0_sdk@2.11.00.07"
 * @versions {"tool":"1.26.2+4477"}
 */

/**
 * Import the modules used in this configuration.
 */
const ADC12  = scripting.addModule("/ti/driverlib/ADC12", {}, false);
const ADC121 = ADC12.addInstance();
const GPIO   = scripting.addModule("/ti/driverlib/GPIO", {}, false);
const GPIO1  = GPIO.addInstance();
const GPIO2  = GPIO.addInstance();
const GPIO3  = GPIO.addInstance();
const GPIO4  = GPIO.addInstance();
const PWM    = scripting.addModule("/ti/driverlib/PWM", {}, false);
const PWM1   = PWM.addInstance();
const SYSCTL = scripting.addModule("/ti/driverlib/SYSCTL");

/**
 * Write custom configuration values to the imported modules.
 */
ADC121.$name                             = "ADC_CAPTURE";
ADC121.repeatMode                        = true;
ADC121.powerDownMode                     = "DL_ADC12_POWER_DOWN_MODE_MANUAL";
ADC121.sampleTime0                       = "62.5 ns";
ADC121.configureDMA                      = true;
ADC121.sampCnt                           = 1;
ADC121.enabledDMATriggers                = ["DL_ADC12_DMA_MEM0_RESULT_LOADED"];
ADC121.peripheral.$assign                = "ADC0";
ADC121.peripheral.adcPin0.$assign        = "PA27";
ADC121.adcPin0Config.$name               = "ti_driverlib_gpio_GPIOPinGeneric0";
ADC121.adcPin0Config.hideOutputInversion = scripting.forceWrite(false);
ADC121.DMA_CHANNEL.$name                 = "ADC_DMA";
ADC121.DMA_CHANNEL.addressMode           = "f2b";
ADC121.DMA_CHANNEL.srcLength             = "HALF_WORD";
ADC121.DMA_CHANNEL.dstLength             = "HALF_WORD";
ADC121.DMA_CHANNEL.peripheral.$assign    = "DMA_CH0";

const Board = scripting.addModule("/ti/driverlib/Board", {}, false);

GPIO1.$name                           = "LCD_DATA";
GPIO1.associatedPins.create(16);
GPIO1.associatedPins[0].$name         = "D0";
GPIO1.associatedPins[0].assignedPort  = "PORTB";
GPIO1.associatedPins[0].assignedPin   = "0";
GPIO1.associatedPins[1].$name         = "D1";
GPIO1.associatedPins[1].assignedPort  = "PORTB";
GPIO1.associatedPins[1].assignedPin   = "1";
GPIO1.associatedPins[2].$name         = "D2";
GPIO1.associatedPins[2].assignedPort  = "PORTB";
GPIO1.associatedPins[2].assignedPin   = "2";
GPIO1.associatedPins[3].$name         = "D3";
GPIO1.associatedPins[3].assignedPort  = "PORTB";
GPIO1.associatedPins[3].assignedPin   = "3";
GPIO1.associatedPins[4].$name         = "D4";
GPIO1.associatedPins[4].assignedPort  = "PORTB";
GPIO1.associatedPins[4].assignedPin   = "4";
GPIO1.associatedPins[5].$name         = "D5";
GPIO1.associatedPins[5].assignedPort  = "PORTB";
GPIO1.associatedPins[5].assignedPin   = "5";
GPIO1.associatedPins[6].$name         = "D6";
GPIO1.associatedPins[6].assignedPort  = "PORTB";
GPIO1.associatedPins[6].assignedPin   = "6";
GPIO1.associatedPins[7].$name         = "D7";
GPIO1.associatedPins[7].assignedPort  = "PORTB";
GPIO1.associatedPins[7].assignedPin   = "7";
GPIO1.associatedPins[8].$name         = "D8";
GPIO1.associatedPins[8].assignedPort  = "PORTB";
GPIO1.associatedPins[8].assignedPin   = "8";
GPIO1.associatedPins[9].$name         = "D9";
GPIO1.associatedPins[9].assignedPort  = "PORTB";
GPIO1.associatedPins[9].assignedPin   = "9";
GPIO1.associatedPins[10].$name        = "D10";
GPIO1.associatedPins[10].assignedPort = "PORTB";
GPIO1.associatedPins[10].assignedPin  = "10";
GPIO1.associatedPins[11].$name        = "D11";
GPIO1.associatedPins[11].assignedPort = "PORTB";
GPIO1.associatedPins[11].assignedPin  = "11";
GPIO1.associatedPins[12].$name        = "D12";
GPIO1.associatedPins[12].assignedPort = "PORTB";
GPIO1.associatedPins[12].assignedPin  = "12";
GPIO1.associatedPins[13].$name        = "D13";
GPIO1.associatedPins[13].assignedPort = "PORTB";
GPIO1.associatedPins[13].assignedPin  = "13";
GPIO1.associatedPins[14].$name        = "D14";
GPIO1.associatedPins[14].assignedPort = "PORTB";
GPIO1.associatedPins[14].assignedPin  = "14";
GPIO1.associatedPins[15].$name        = "D15";
GPIO1.associatedPins[15].assignedPort = "PORTB";
GPIO1.associatedPins[15].assignedPin  = "15";

GPIO2.$name                          = "LCD_CTRL";
GPIO2.associatedPins.create(6);
GPIO2.associatedPins[0].$name        = "WR";
GPIO2.associatedPins[0].assignedPort = "PORTA";
GPIO2.associatedPins[0].assignedPin  = "8";
GPIO2.associatedPins[0].initialValue = "SET";
GPIO2.associatedPins[1].$name        = "RD";
GPIO2.associatedPins[1].assignedPort = "PORTA";
GPIO2.associatedPins[1].assignedPin  = "9";
GPIO2.associatedPins[1].initialValue = "SET";
GPIO2.associatedPins[2].$name        = "CS";
GPIO2.associatedPins[2].assignedPort = "PORTA";
GPIO2.associatedPins[2].assignedPin  = "12";
GPIO2.associatedPins[2].initialValue = "SET";
GPIO2.associatedPins[3].$name        = "RS";
GPIO2.associatedPins[3].assignedPort = "PORTA";
GPIO2.associatedPins[3].assignedPin  = "13";
GPIO2.associatedPins[3].initialValue = "SET";
GPIO2.associatedPins[4].$name        = "RST";
GPIO2.associatedPins[4].assignedPort = "PORTA";
GPIO2.associatedPins[4].assignedPin  = "14";
GPIO2.associatedPins[4].initialValue = "SET";
GPIO2.associatedPins[5].$name        = "BL";
GPIO2.associatedPins[5].assignedPort = "PORTA";
GPIO2.associatedPins[5].assignedPin  = "15";

GPIO3.$name                              = "KEYS";
GPIO3.port                               = "PORTC";
GPIO3.associatedPins.create(12);
GPIO3.associatedPins[0].$name            = "KEY1";
GPIO3.associatedPins[0].direction        = "INPUT";
GPIO3.associatedPins[0].assignedPin      = "12";
GPIO3.associatedPins[0].internalResistor = "PULL_UP";
GPIO3.associatedPins[1].$name            = "KEY2";
GPIO3.associatedPins[1].direction        = "INPUT";
GPIO3.associatedPins[1].assignedPin      = "15";
GPIO3.associatedPins[1].internalResistor = "PULL_UP";
GPIO3.associatedPins[2].$name            = "KEY3";
GPIO3.associatedPins[2].direction        = "INPUT";
GPIO3.associatedPins[2].assignedPin      = "16";
GPIO3.associatedPins[2].internalResistor = "PULL_UP";
GPIO3.associatedPins[3].$name            = "KEY4";
GPIO3.associatedPins[3].direction        = "INPUT";
GPIO3.associatedPins[3].assignedPin      = "18";
GPIO3.associatedPins[3].internalResistor = "PULL_UP";
GPIO3.associatedPins[4].$name            = "KEY5";
GPIO3.associatedPins[4].direction        = "INPUT";
GPIO3.associatedPins[4].assignedPin      = "20";
GPIO3.associatedPins[4].internalResistor = "PULL_UP";
GPIO3.associatedPins[5].$name            = "KEY6";
GPIO3.associatedPins[5].direction        = "INPUT";
GPIO3.associatedPins[5].assignedPin      = "23";
GPIO3.associatedPins[5].internalResistor = "PULL_UP";
GPIO3.associatedPins[6].$name            = "KEY7";
GPIO3.associatedPins[6].direction        = "INPUT";
GPIO3.associatedPins[6].assignedPin      = "24";
GPIO3.associatedPins[6].internalResistor = "PULL_UP";
GPIO3.associatedPins[7].$name            = "KEY8";
GPIO3.associatedPins[7].direction        = "INPUT";
GPIO3.associatedPins[7].assignedPin      = "17";
GPIO3.associatedPins[7].internalResistor = "PULL_UP";
GPIO3.associatedPins[8].$name            = "KEY9";
GPIO3.associatedPins[8].direction        = "INPUT";
GPIO3.associatedPins[8].assignedPin      = "19";
GPIO3.associatedPins[8].internalResistor = "PULL_UP";
GPIO3.associatedPins[9].$name            = "KEY10";
GPIO3.associatedPins[9].direction        = "INPUT";
GPIO3.associatedPins[9].assignedPin      = "4";
GPIO3.associatedPins[9].internalResistor = "PULL_UP";
GPIO3.associatedPins[10].$name            = "KEY11";
GPIO3.associatedPins[10].direction        = "INPUT";
GPIO3.associatedPins[10].assignedPin      = "5";
GPIO3.associatedPins[10].internalResistor = "PULL_UP";
GPIO3.associatedPins[11].$name            = "KEY12";
GPIO3.associatedPins[11].direction        = "INPUT";
GPIO3.associatedPins[11].assignedPin      = "8";
GPIO3.associatedPins[11].internalResistor = "PULL_UP";

GPIO4.$name                          = "GPIO_LEDS";
GPIO4.port                           = "PORTB";
GPIO4.associatedPins[0].$name        = "USER_LED_1";
GPIO4.associatedPins[0].assignedPin  = "22";
GPIO4.associatedPins[0].initialValue = "CLEARED";

PWM1.$name                   = "PWM_0";
PWM1.peripheral.$assign      = "TIMA0";
PWM1.pwmMode                 = "CENTER_ALIGN";
PWM1.timerCount              = 1600;
PWM1.enableShadowLoad        = true;
PWM1.interrupts              = ["ZERO_EVENT"];
PWM1.PWM_CHANNEL_0.$name     = "ti_driverlib_pwm_PWMTimerCC0";
PWM1.PWM_CHANNEL_0.dutyCycle = 50;
PWM1.PWM_CHANNEL_0.shadowUpdateMode = "ZERO_EVT";
PWM1.PWM_CHANNEL_1.$name     = "ti_driverlib_pwm_PWMTimerCC1";
PWM1.PWM_CHANNEL_1.dutyCycle = 50;
PWM1.PWM_CHANNEL_1.shadowUpdateMode = "ZERO_EVT";
PWM1.ccp0PinConfig.$name     = "ti_driverlib_gpio_GPIOPinGeneric1";
PWM1.ccp1PinConfig.$name     = "ti_driverlib_gpio_GPIOPinGeneric2";

SYSCTL.forceDefaultClkConfig = true;
SYSCTL.clockTreeEn           = true;

/**
 * Pinmux solution for unlocked pins/peripherals. This ensures that minor changes to the automatic solver in a future
 * version of the tool will not impact the pinmux you originally saw.  These lines can be completely deleted in order to
 * re-solve from scratch.
 */
Board.peripheral.$suggestSolution             = "DEBUGSS";
Board.peripheral.swclkPin.$suggestSolution    = "PA20";
Board.peripheral.swdioPin.$suggestSolution    = "PA19";
GPIO1.associatedPins[0].pin.$suggestSolution  = "PB0";
GPIO1.associatedPins[1].pin.$suggestSolution  = "PB1";
GPIO1.associatedPins[2].pin.$suggestSolution  = "PB2";
GPIO1.associatedPins[3].pin.$suggestSolution  = "PB3";
GPIO1.associatedPins[4].pin.$suggestSolution  = "PB4";
GPIO1.associatedPins[5].pin.$suggestSolution  = "PB5";
GPIO1.associatedPins[6].pin.$suggestSolution  = "PB6";
GPIO1.associatedPins[7].pin.$suggestSolution  = "PB7";
GPIO1.associatedPins[8].pin.$suggestSolution  = "PB8";
GPIO1.associatedPins[9].pin.$suggestSolution  = "PB9";
GPIO1.associatedPins[10].pin.$suggestSolution = "PB10";
GPIO1.associatedPins[11].pin.$suggestSolution = "PB11";
GPIO1.associatedPins[12].pin.$suggestSolution = "PB12";
GPIO1.associatedPins[13].pin.$suggestSolution = "PB13";
GPIO1.associatedPins[14].pin.$suggestSolution = "PB14";
GPIO1.associatedPins[15].pin.$suggestSolution = "PB15";
GPIO2.associatedPins[0].pin.$suggestSolution  = "PA8";
GPIO2.associatedPins[1].pin.$suggestSolution  = "PA9";
GPIO2.associatedPins[2].pin.$suggestSolution  = "PA12";
GPIO2.associatedPins[3].pin.$suggestSolution  = "PA13";
GPIO2.associatedPins[4].pin.$suggestSolution  = "PA14";
GPIO2.associatedPins[5].pin.$suggestSolution  = "PA15";
GPIO3.associatedPins[0].pin.$suggestSolution  = "PC12";
GPIO3.associatedPins[1].pin.$suggestSolution  = "PC15";
GPIO3.associatedPins[2].pin.$suggestSolution  = "PC16";
GPIO3.associatedPins[3].pin.$suggestSolution  = "PC18";
GPIO3.associatedPins[4].pin.$suggestSolution  = "PC20";
GPIO3.associatedPins[5].pin.$suggestSolution  = "PC23";
GPIO3.associatedPins[6].pin.$suggestSolution  = "PC24";
GPIO3.associatedPins[7].pin.$suggestSolution  = "PC17";
GPIO3.associatedPins[8].pin.$suggestSolution  = "PC19";
GPIO3.associatedPins[9].pin.$suggestSolution  = "PC4";
GPIO3.associatedPins[10].pin.$suggestSolution = "PC5";
GPIO3.associatedPins[11].pin.$suggestSolution = "PC8";
GPIO4.associatedPins[0].pin.$suggestSolution  = "PB22";
PWM1.peripheral.ccp0Pin.$suggestSolution      = "PA0";
PWM1.peripheral.ccp1Pin.$suggestSolution      = "PA1";
