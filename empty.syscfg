/**
 * @cliArgs --device "MSPM0G351X" --part "Default" --package "LQFP-100(PZ)" --product "mspm0_sdk@2.11.00.07"
 * @versions {"tool":"1.26.2+4477"}
 */

/**
 * Import the modules used in this configuration.
 */
const ADC12  = scripting.addModule("/ti/driverlib/ADC12", {}, false);
const ADC121 = ADC12.addInstance();
const ADC122 = ADC12.addInstance();
const DAC12  = scripting.addModule("/ti/driverlib/DAC12");
const GPIO   = scripting.addModule("/ti/driverlib/GPIO", {}, false);
const GPIO1  = GPIO.addInstance();
const GPIO2  = GPIO.addInstance();
const GPIO3  = GPIO.addInstance();
const GPIO4  = GPIO.addInstance();
const GPIO5  = GPIO.addInstance();
const PWM    = scripting.addModule("/ti/driverlib/PWM", {}, false);
const PWM1   = PWM.addInstance();
const SYSCTL = scripting.addModule("/ti/driverlib/SYSCTL");
const TIMER  = scripting.addModule("/ti/driverlib/TIMER", {}, false);
const TIMER1 = TIMER.addInstance();

/**
 * Write custom configuration values to the imported modules.
 */
/*
 * ADC0 四通道序列采样：每个 TIMG0 周期依次转换 PA27、PA26、PA25、PA24。
 * FIFO 将两个 12 位结果打包为一个 32 位字，再由 DMA_CH0 搬入双缓冲区。
 */
ADC121.$name                             = "ADC_CAPTURE";
ADC121.repeatMode                        = false;
ADC121.powerDownMode                     = "DL_ADC12_POWER_DOWN_MODE_MANUAL";
ADC121.samplingOperationMode             = "sequence";
ADC121.endAdd                            = 3;
ADC121.trigSrc                           = "DL_ADC12_TRIG_SRC_EVENT";
ADC121.subChanID                         = 1;
ADC121.sampleTime0                       = "250 ns";
ADC121.adcMem0chansel                    = "DL_ADC12_INPUT_CHAN_0";
ADC121.adcMem1chansel                    = "DL_ADC12_INPUT_CHAN_1";
ADC121.adcMem2chansel                    = "DL_ADC12_INPUT_CHAN_2";
ADC121.adcMem3chansel                    = "DL_ADC12_INPUT_CHAN_3";
ADC121.configureDMA                      = true;
ADC121.enableFIFO                        = true;
ADC121.sampCnt                           = 2;
ADC121.enabledDMATriggers                = ["DL_ADC12_DMA_MEM3_RESULT_LOADED"];
ADC121.enabledInterrupts                 = ["DL_ADC12_INTERRUPT_DMA_DONE"];
ADC121.peripheral.$assign                = "ADC0";
ADC121.peripheral.adcPin0.$assign        = "PA27";
ADC121.peripheral.adcPin1.$assign        = "PA26";
ADC121.peripheral.adcPin2.$assign        = "PA25";
ADC121.peripheral.adcPin3.$assign        = "PA24";
ADC121.adcPin0Config.$name               = "ti_driverlib_gpio_GPIOPinGeneric0";
ADC121.adcPin0Config.hideOutputInversion = scripting.forceWrite(false);
ADC121.DMA_CHANNEL.$name                 = "ADC_DMA";
ADC121.DMA_CHANNEL.addressMode           = "f2b";
ADC121.DMA_CHANNEL.peripheral.$assign    = "DMA_CH0";

/*
 * ADC1 高速单通道：PB27 对应 ADC1 通道14。
 * 软件启动后由 ADC 自身连续重复转换，不使用定时器；FIFO 每次把两个
 * 12 位结果打包为一个32位字，DMA_CH1负责搬入驱动双缓冲区。
 */
ADC122.$name                          = "ADC1_FAST";
ADC122.repeatMode                     = true;
ADC122.sampleTime0                    = "62.5 ns";
ADC122.powerDownMode                  = "DL_ADC12_POWER_DOWN_MODE_MANUAL";
ADC122.enableFIFO                     = true;
ADC122.configureDMA                   = true;
ADC122.sampCnt                        = 6;
ADC122.enabledDMATriggers             = ["DL_ADC12_DMA_MEM10_RESULT_LOADED"];
ADC122.enabledInterrupts              = ["DL_ADC12_INTERRUPT_DMA_DONE"];
ADC122.adcMem0chansel                 = "DL_ADC12_INPUT_CHAN_14";
ADC122.peripheral.$assign             = "ADC1";
ADC122.peripheral.adcPin14.$assign    = "PB27";
ADC122.adcPin14Config.$name           = "ti_driverlib_gpio_GPIOPinGeneric3";
ADC122.adcPin14Config.hideOutputInversion = scripting.forceWrite(false);
ADC122.DMA_CHANNEL.$name              = "ADC1_FAST_DMA";
ADC122.DMA_CHANNEL.addressMode        = "f2b";
ADC122.DMA_CHANNEL.peripheral.$assign = "DMA_CH1";

/*
 * DAC0固定输出脚为PA15。DMA_CH2循环搬运波形表，DAC内部采样发生器负责
 * 更新节拍，不占用通用定时器。采样发生器默认关闭，由驱动按需启动。
 */
const gate8 = system.clockTree["MFPCLKGATE"];
gate8.enable = true;
DAC12.dacConfigureDMA                = true;
DAC12.dacFIFOEn                      = true;
DAC12.dacFIFOThresh                  = "TWO_QTRS_EMPTY";
DAC12.dacFIFOTrigger                 = "SAMPLETIMER";
DAC12.dacEnabledInterrupts           = ["FIFO_UNDERRUN"];
DAC12.dacOutputPinEn                 = true;
DAC12.dacAmplifier                   = "ON";
DAC12.dacSampleTimerEn               = true;
DAC12.dacSampleTimerRate             = "1M";
DAC12.peripheral.$assign             = "DAC0";
DAC12.peripheral.OutPin.$assign      = "PA15";
DAC12.OutPinConfig.$name             = "DAC0_OUT_PIN_CONFIG";
DAC12.OutPinConfig.hideOutputInversion = scripting.forceWrite(false);
DAC12.DMA_CHANNEL.$name              = "DAC_DMA";
DAC12.DMA_CHANNEL.transferMode       = "FULL_CH_REPEAT_SINGLE";
DAC12.DMA_CHANNEL.addressMode        = "b2f";
DAC12.DMA_CHANNEL.srcLength          = "HALF_WORD";
DAC12.DMA_CHANNEL.dstLength          = "HALF_WORD";
DAC12.DMA_CHANNEL.peripheral.$assign = "DMA_CH2";

const Board = scripting.addModule("/ti/driverlib/Board", {}, false);

GPIO1.$name                           = "LCD_DATA";
GPIO1.associatedPins.create(16);
GPIO1.associatedPins[0].$name         = "D0";
GPIO1.associatedPins[0].assignedPort  = "PORTB";
GPIO1.associatedPins[0].assignedPin   = "0";
GPIO1.associatedPins[1].$name         = "D1";
GPIO1.associatedPins[1].assignedPort  = "PORTB";
GPIO1.associatedPins[1].assignedPin   = "1";
GPIO1.associatedPins[2].$name         = "D2";
GPIO1.associatedPins[2].assignedPort  = "PORTB";
GPIO1.associatedPins[2].assignedPin   = "2";
GPIO1.associatedPins[3].$name         = "D3";
GPIO1.associatedPins[3].assignedPort  = "PORTB";
GPIO1.associatedPins[3].assignedPin   = "3";
GPIO1.associatedPins[4].$name         = "D4";
GPIO1.associatedPins[4].assignedPort  = "PORTB";
GPIO1.associatedPins[4].assignedPin   = "4";
GPIO1.associatedPins[5].$name         = "D5";
GPIO1.associatedPins[5].assignedPort  = "PORTB";
GPIO1.associatedPins[5].assignedPin   = "5";
GPIO1.associatedPins[6].$name         = "D6";
GPIO1.associatedPins[6].assignedPort  = "PORTB";
GPIO1.associatedPins[6].assignedPin   = "6";
GPIO1.associatedPins[7].$name         = "D7";
GPIO1.associatedPins[7].assignedPort  = "PORTB";
GPIO1.associatedPins[7].assignedPin   = "7";
GPIO1.associatedPins[8].$name         = "D8";
GPIO1.associatedPins[8].assignedPort  = "PORTB";
GPIO1.associatedPins[8].assignedPin   = "8";
GPIO1.associatedPins[9].$name         = "D9";
GPIO1.associatedPins[9].assignedPort  = "PORTB";
GPIO1.associatedPins[9].assignedPin   = "9";
GPIO1.associatedPins[10].$name        = "D10";
GPIO1.associatedPins[10].assignedPort = "PORTB";
GPIO1.associatedPins[10].assignedPin  = "10";
GPIO1.associatedPins[11].$name        = "D11";
GPIO1.associatedPins[11].assignedPort = "PORTB";
GPIO1.associatedPins[11].assignedPin  = "11";
GPIO1.associatedPins[12].$name        = "D12";
GPIO1.associatedPins[12].assignedPort = "PORTB";
GPIO1.associatedPins[12].assignedPin  = "12";
GPIO1.associatedPins[13].$name        = "D13";
GPIO1.associatedPins[13].assignedPort = "PORTB";
GPIO1.associatedPins[13].assignedPin  = "13";
GPIO1.associatedPins[14].$name        = "D14";
GPIO1.associatedPins[14].assignedPort = "PORTB";
GPIO1.associatedPins[14].assignedPin  = "14";
GPIO1.associatedPins[15].$name        = "D15";
GPIO1.associatedPins[15].assignedPort = "PORTB";
GPIO1.associatedPins[15].assignedPin  = "15";

GPIO2.$name                          = "LCD_CTRL";
GPIO2.associatedPins.create(5);
GPIO2.associatedPins[0].$name        = "WR";
GPIO2.associatedPins[0].assignedPort = "PORTA";
GPIO2.associatedPins[0].assignedPin  = "8";
GPIO2.associatedPins[0].initialValue = "SET";
GPIO2.associatedPins[1].$name        = "RD";
GPIO2.associatedPins[1].assignedPort = "PORTA";
GPIO2.associatedPins[1].assignedPin  = "9";
GPIO2.associatedPins[1].initialValue = "SET";
GPIO2.associatedPins[2].$name        = "CS";
GPIO2.associatedPins[2].assignedPort = "PORTA";
GPIO2.associatedPins[2].assignedPin  = "12";
GPIO2.associatedPins[2].initialValue = "SET";
GPIO2.associatedPins[3].$name        = "RS";
GPIO2.associatedPins[3].assignedPort = "PORTA";
GPIO2.associatedPins[3].assignedPin  = "13";
GPIO2.associatedPins[3].initialValue = "SET";
GPIO2.associatedPins[4].$name        = "RST";
GPIO2.associatedPins[4].assignedPort = "PORTA";
GPIO2.associatedPins[4].assignedPin  = "14";
GPIO2.associatedPins[4].initialValue = "SET";

/* LCD背光独立使用PB16普通GPIO，为DAC0释放其唯一输出脚PA15。 */
GPIO5.$name                          = "LCD_BACKLIGHT";
GPIO5.port                           = "PORTB";
GPIO5.associatedPins[0].$name        = "BL";
GPIO5.associatedPins[0].assignedPin  = "16";
GPIO5.associatedPins[0].initialValue = "CLEARED";

GPIO3.$name                              = "KEYS";
GPIO3.port                               = "PORTC";
GPIO3.associatedPins.create(12);
GPIO3.associatedPins[0].$name            = "KEY1";
GPIO3.associatedPins[0].direction        = "INPUT";
GPIO3.associatedPins[0].assignedPin      = "12";
GPIO3.associatedPins[0].internalResistor = "PULL_UP";
GPIO3.associatedPins[1].$name            = "KEY2";
GPIO3.associatedPins[1].direction        = "INPUT";
GPIO3.associatedPins[1].assignedPin      = "15";
GPIO3.associatedPins[1].internalResistor = "PULL_UP";
GPIO3.associatedPins[2].$name            = "KEY3";
GPIO3.associatedPins[2].direction        = "INPUT";
GPIO3.associatedPins[2].assignedPin      = "16";
GPIO3.associatedPins[2].internalResistor = "PULL_UP";
GPIO3.associatedPins[3].$name            = "KEY4";
GPIO3.associatedPins[3].direction        = "INPUT";
GPIO3.associatedPins[3].assignedPin      = "18";
GPIO3.associatedPins[3].internalResistor = "PULL_UP";
GPIO3.associatedPins[4].$name            = "KEY5";
GPIO3.associatedPins[4].direction        = "INPUT";
GPIO3.associatedPins[4].assignedPin      = "20";
GPIO3.associatedPins[4].internalResistor = "PULL_UP";
GPIO3.associatedPins[5].$name            = "KEY6";
GPIO3.associatedPins[5].direction        = "INPUT";
GPIO3.associatedPins[5].assignedPin      = "23";
GPIO3.associatedPins[5].internalResistor = "PULL_UP";
GPIO3.associatedPins[6].$name            = "KEY7";
GPIO3.associatedPins[6].direction        = "INPUT";
GPIO3.associatedPins[6].assignedPin      = "24";
GPIO3.associatedPins[6].internalResistor = "PULL_UP";
GPIO3.associatedPins[7].$name            = "KEY8";
GPIO3.associatedPins[7].direction        = "INPUT";
GPIO3.associatedPins[7].assignedPin      = "17";
GPIO3.associatedPins[7].internalResistor = "PULL_UP";
GPIO3.associatedPins[8].$name            = "KEY9";
GPIO3.associatedPins[8].direction        = "INPUT";
GPIO3.associatedPins[8].assignedPin      = "19";
GPIO3.associatedPins[8].internalResistor = "PULL_UP";
GPIO3.associatedPins[9].$name            = "KEY10";
GPIO3.associatedPins[9].direction        = "INPUT";
GPIO3.associatedPins[9].assignedPin      = "4";
GPIO3.associatedPins[9].internalResistor = "PULL_UP";
GPIO3.associatedPins[10].$name            = "KEY11";
GPIO3.associatedPins[10].direction        = "INPUT";
GPIO3.associatedPins[10].assignedPin      = "5";
GPIO3.associatedPins[10].internalResistor = "PULL_UP";
GPIO3.associatedPins[11].$name            = "KEY12";
GPIO3.associatedPins[11].direction        = "INPUT";
GPIO3.associatedPins[11].assignedPin      = "8";
GPIO3.associatedPins[11].internalResistor = "PULL_UP";

GPIO4.$name                          = "GPIO_LEDS";
GPIO4.port                           = "PORTB";
GPIO4.associatedPins[0].$name        = "USER_LED_1";
GPIO4.associatedPins[0].assignedPin  = "22";
GPIO4.associatedPins[0].initialValue = "CLEARED";

PWM1.$name                   = "PWM_0";
PWM1.peripheral.$assign      = "TIMA0";
PWM1.pwmMode                 = "CENTER_ALIGN";
PWM1.timerCount              = 1600;
PWM1.enableShadowLoad        = true;
PWM1.interrupts              = ["ZERO_EVENT"];
PWM1.PWM_CHANNEL_0.$name     = "ti_driverlib_pwm_PWMTimerCC0";
PWM1.PWM_CHANNEL_0.dutyCycle = 50;
PWM1.PWM_CHANNEL_0.shadowUpdateMode = "ZERO_EVT";
PWM1.PWM_CHANNEL_1.$name     = "ti_driverlib_pwm_PWMTimerCC1";
PWM1.PWM_CHANNEL_1.dutyCycle = 50;
PWM1.PWM_CHANNEL_1.shadowUpdateMode = "ZERO_EVT";
PWM1.ccp0PinConfig.$name     = "ti_driverlib_gpio_GPIOPinGeneric1";
PWM1.ccp1PinConfig.$name     = "ti_driverlib_gpio_GPIOPinGeneric2";

/* 硬件初始周期为 100 kframe/s；驱动启动时会按请求值重设 TIMG0。 */
TIMER1.$name                       = "ADC_SAMPLE_TIMER";
TIMER1.timerMode                   = "PERIODIC";
TIMER1.timerPeriod                 = "10 us";
TIMER1.event1PublisherChannel      = 1;
TIMER1.event1ControllerInterruptEn = ["ZERO_EVENT"];
TIMER1.peripheral.$assign          = "TIMG0";

SYSCTL.forceDefaultClkConfig = true;
SYSCTL.clockTreeEn           = true;
SYSCTL.MFPCLKEn              = true;

/**
 * Pinmux solution for unlocked pins/peripherals. This ensures that minor changes to the automatic solver in a future
 * version of the tool will not impact the pinmux you originally saw.  These lines can be completely deleted in order to
 * re-solve from scratch.
 */
Board.peripheral.$suggestSolution             = "DEBUGSS";
Board.peripheral.swclkPin.$suggestSolution    = "PA20";
Board.peripheral.swdioPin.$suggestSolution    = "PA19";
GPIO1.associatedPins[0].pin.$suggestSolution  = "PB0";
GPIO1.associatedPins[1].pin.$suggestSolution  = "PB1";
GPIO1.associatedPins[2].pin.$suggestSolution  = "PB2";
GPIO1.associatedPins[3].pin.$suggestSolution  = "PB3";
GPIO1.associatedPins[4].pin.$suggestSolution  = "PB4";
GPIO1.associatedPins[5].pin.$suggestSolution  = "PB5";
GPIO1.associatedPins[6].pin.$suggestSolution  = "PB6";
GPIO1.associatedPins[7].pin.$suggestSolution  = "PB7";
GPIO1.associatedPins[8].pin.$suggestSolution  = "PB8";
GPIO1.associatedPins[9].pin.$suggestSolution  = "PB9";
GPIO1.associatedPins[10].pin.$suggestSolution = "PB10";
GPIO1.associatedPins[11].pin.$suggestSolution = "PB11";
GPIO1.associatedPins[12].pin.$suggestSolution = "PB12";
GPIO1.associatedPins[13].pin.$suggestSolution = "PB13";
GPIO1.associatedPins[14].pin.$suggestSolution = "PB14";
GPIO1.associatedPins[15].pin.$suggestSolution = "PB15";
GPIO2.associatedPins[0].pin.$suggestSolution  = "PA8";
GPIO2.associatedPins[1].pin.$suggestSolution  = "PA9";
GPIO2.associatedPins[2].pin.$suggestSolution  = "PA12";
GPIO2.associatedPins[3].pin.$suggestSolution  = "PA13";
GPIO2.associatedPins[4].pin.$suggestSolution  = "PA14";
GPIO3.associatedPins[0].pin.$suggestSolution  = "PC12";
GPIO3.associatedPins[1].pin.$suggestSolution  = "PC15";
GPIO3.associatedPins[2].pin.$suggestSolution  = "PC16";
GPIO3.associatedPins[3].pin.$suggestSolution  = "PC18";
GPIO3.associatedPins[4].pin.$suggestSolution  = "PC20";
GPIO3.associatedPins[5].pin.$suggestSolution  = "PC23";
GPIO3.associatedPins[6].pin.$suggestSolution  = "PC24";
GPIO3.associatedPins[7].pin.$suggestSolution  = "PC17";
GPIO3.associatedPins[8].pin.$suggestSolution  = "PC19";
GPIO3.associatedPins[9].pin.$suggestSolution  = "PC4";
GPIO3.associatedPins[10].pin.$suggestSolution = "PC5";
GPIO3.associatedPins[11].pin.$suggestSolution = "PC8";
GPIO4.associatedPins[0].pin.$suggestSolution  = "PB22";
GPIO5.associatedPins[0].pin.$suggestSolution  = "PB16";
PWM1.peripheral.ccp0Pin.$suggestSolution      = "PA0";
PWM1.peripheral.ccp1Pin.$suggestSolution      = "PA1";
